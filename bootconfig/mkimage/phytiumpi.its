## bootconfig/mkimage/phytiumpi.its
```
/dts-v1/;
/ {
        description = "U-Boot fitImage for Phytium Phytiumpi";
        #address-cells = <1>;

        images {
                kernel {
                        description = "Linux kernel";
                        data = /incbin/("Image.gz");
                        type = "kernel";
                        arch = "arm64";
                        os = "linux";
                        compression = "gzip";
                        load =  <0x80080000>;
                        entry = <0x80080000>;
                        hash-1 {
                                algo = "sha1";
                        };
                };

                ramdisk {
                        description = "ramdisk";
                        data = /incbin/("initrd.img");
                        type = "ramdisk";
                        arch = "arm64";
                        os = "linux";
                        compression = "gzip";
                        hash-1 {
                                algo = "sha1";
                        };
                };

                fdt-phytium {
                        description = "FDT phytiumpi";
                        data = /incbin/("phytiumpi_firefly.dtb");
                        type = "flat_dt";
                        arch = "arm64";
                        compression = "none";
                        hash-1 {
                                algo = "sha1";
                        };
                };
        };

        configurations {
                default = "phytium@cecport";

                phytium {
                        description = "phytimpi";
                        kernel = "kernel";
                        fdt = "fdt-phytium";
                        ramdisk = "ramdisk";
                        hash-1 {
                                algo = "sha1";
                        };
                };

        };
};
```
